## panda_ai/main/Kconfig.projbuild
```kconfig
menu "Panda AI"

    config PANDA_BATTERY_ADC
        bool "Enable battery voltage measurement on GPIO1"
        default n
        help
            The board schematic (1.1) routes BAT_ADC to GPIO1 only when the
            0R links at R53/R78 are fitted; they are unpopulated by default,
            so GPIO1 floats. Fitting them makes camera HREF unavailable.

    config PANDA_BATTERY_DIVIDER_MILLI
        int "Battery divider ratio x1000 (Vbat / Vadc)"
        default 3000
        depends on PANDA_BATTERY_ADC
        help
            Schematic 1.1 divides BAT_OUT with R2=200K (upper) and R11=100K
            (lower), so Vbat = Vadc x 3. BAT_OUT is the selected system rail
            and reads about 5 V while USB is plugged in.

    config PANDA_DEBUG_VERBOSE
        bool "Verbose debug logs and periodic diagnostics"
        default y

    config PANDA_UI_FPS
        int "UI target FPS"
        range 10 60
        default 30

    config PANDA_SERIAL_CLI
        bool "Enable USB-SERIAL-JTAG serial command line"
        default y

    config PANDA_PROVISIONING
        bool "Enable HTTP provisioning page on port 80"
        default y

    config PANDA_WIFI_AP_PREFIX
        string "Provisioning SoftAP SSID prefix"
        default "Panda-AI"

    config PANDA_WIFI_AP_PASSWORD
        string "Provisioning SoftAP password (>=8 chars, empty for open)"
        default "pandapanda"

    config PANDA_SNTP_SERVER
        string "SNTP server for RTC sync"
        default "pool.ntp.org"

endmenu
```

## panda_ai/sdkconfig.defaults
```kconfig
# Panda AI pendant - ESP32-S3 N16R8
CONFIG_IDF_TARGET="esp32s3"
CONFIG_ESPTOOLPY_FLASHSIZE_16MB=y
CONFIG_ESPTOOLPY_FLASHMODE_QIO=y
CONFIG_ESPTOOLPY_FLASHFREQ_80M=y
CONFIG_PARTITION_TABLE_CUSTOM=y
CONFIG_PARTITION_TABLE_CUSTOM_FILENAME="partitions.csv"
CONFIG_PARTITION_TABLE_OFFSET=0x8000

# CPU / RTOS
CONFIG_ESP32S3_DEFAULT_CPU_FREQ_240=y
CONFIG_FREERTOS_HZ=1000
CONFIG_FREERTOS_TIMER_TASK_STACK_DEPTH=4096
CONFIG_ESP_MAIN_TASK_STACK_SIZE=8192
CONFIG_ESP_SYSTEM_EVENT_TASK_STACK_SIZE=4096
CONFIG_ESP_TIMER_TASK_STACK_SIZE=4096
CONFIG_PTHREAD_TASK_STACK_SIZE_DEFAULT=4096

# PSRAM (8 MB octal)
CONFIG_SPIRAM=y
CONFIG_SPIRAM_MODE_OCT=y
CONFIG_SPIRAM_TYPE_AUTO=y
CONFIG_SPIRAM_SPEED_80M=y
CONFIG_SPIRAM_BOOT_INIT=y
CONFIG_SPIRAM_USE_MALLOC=y
CONFIG_SPIRAM_MALLOC_ALWAYSINTERNAL=4096
CONFIG_SPIRAM_MALLOC_RESERVE_INTERNAL=65536
CONFIG_SPIRAM_TRY_ALLOCATE_WIFI_LWIP=y
CONFIG_SPIRAM_ALLOW_STACK_EXTERNAL_MEMORY=y
CONFIG_SPIRAM_MEMTEST=y

# Console / logs
CONFIG_ESP_CONSOLE_USB_SERIAL_JTAG=y
CONFIG_ESP_CONSOLE_SECONDARY_NONE=y
CONFIG_LOG_DEFAULT_LEVEL_INFO=y
CONFIG_LOG_MAXIMUM_LEVEL_DEBUG=y
CONFIG_LOG_COLORS=y
CONFIG_BOOTLOADER_LOG_LEVEL_INFO=y

# Watchdog / crash diagnostics
CONFIG_ESP_TASK_WDT_EN=y
CONFIG_ESP_TASK_WDT_INIT=y
CONFIG_ESP_TASK_WDT_TIMEOUT_S=30
CONFIG_ESP_TASK_WDT_CHECK_IDLE_TASK_CPU0=y
CONFIG_ESP_TASK_WDT_CHECK_IDLE_TASK_CPU1=y
CONFIG_ESP_COREDUMP_ENABLE_TO_FLASH=y
CONFIG_ESP_COREDUMP_DATA_FORMAT_ELF=y
CONFIG_ESP_COREDUMP_CHECKSUM_CRC32=y

# Compiler
CONFIG_COMPILER_OPTIMIZATION_PERF=y
CONFIG_COMPILER_WARN_WRITE_STRINGS=y

# WiFi / TCP
# RX buffers follow the vendor demo (STATIC_RX 6, BA_WIN 6); ESP-IDF requires
# STATIC_RX >= 6 with AMPDU and BA_WIN <= 2*STATIC_RX.
CONFIG_ESP_WIFI_STATIC_RX_BUFFER_NUM=6
CONFIG_ESP_WIFI_DYNAMIC_RX_BUFFER_NUM=16
CONFIG_ESP_WIFI_RX_BA_WIN=6
CONFIG_ESP_WIFI_DYNAMIC_TX_BUFFER_NUM=32
CONFIG_LWIP_MAX_SOCKETS=16
CONFIG_LWIP_TCP_MSS=1440
# Demo-proven window sizes: 32 KB in-flight bursts starved the driver and
# wedged the data path during TTS; 5.7 KB is plenty for 32 KB/s streams.
CONFIG_LWIP_TCP_SND_BUF_DEFAULT=5760
CONFIG_LWIP_TCP_WND_DEFAULT=5760
CONFIG_LWIP_TCP_RECVMBOX_SIZE=6
CONFIG_LWIP_TCPIP_RECVMBOX_SIZE=32
CONFIG_LWIP_TCP_HIGH_SPEED_RETRANSMISSION=y
CONFIG_LWIP_TCP_RTO_TIME=1500

# TLS: large buffers in PSRAM, dynamic trim
CONFIG_MBEDTLS_EXTERNAL_MEM_ALLOC=y
CONFIG_MBEDTLS_DYNAMIC_BUFFER=y
CONFIG_MBEDTLS_SSL_IN_CONTENT_LEN=16384
CONFIG_MBEDTLS_SSL_OUT_CONTENT_LEN=4096

# Battery: BAT_ADC on GPIO1 (0R link populated on this board)
CONFIG_PANDA_BATTERY_ADC=y
CONFIG_PANDA_BATTERY_DIVIDER_MILLI=3000

# FatFS / SD
CONFIG_FATFS_LFN_HEAP=y
CONFIG_FATFS_MAX_LFN=255
CONFIG_FATFS_API_ENCODING_UTF_8=y

# LVGL 9
CONFIG_LV_COLOR_DEPTH_16=y
CONFIG_LV_MEM_SIZE_KILOBYTES=96
CONFIG_LV_DEF_REFR_PERIOD=20
CONFIG_LV_DPI_DEF=200
CONFIG_LV_FONT_MONTSERRAT_12=y
CONFIG_LV_FONT_MONTSERRAT_14=y
CONFIG_LV_FONT_MONTSERRAT_16=y
CONFIG_LV_FONT_MONTSERRAT_20=y
CONFIG_LV_FONT_MONTSERRAT_28=y
CONFIG_LV_FONT_SOURCE_HAN_SANS_SC_14_CJK=y
CONFIG_LV_FONT_SOURCE_HAN_SANS_SC_16_CJK=y
CONFIG_LV_USE_LOG=n
CONFIG_LV_USE_PERF_MONITOR=n
CONFIG_LV_USE_MEM_MONITOR=n

CONFIG_WS_BUFFER_SIZE=4096
```
